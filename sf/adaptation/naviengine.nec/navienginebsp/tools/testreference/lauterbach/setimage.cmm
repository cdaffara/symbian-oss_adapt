//
// Copyright (c) 2008-2009 Nokia Corporation and/or its subsidiary(-ies).
// All rights reserved.
// This component and the accompanying materials are made available
// under the terms of "Eclipse Public License v1.0"
// which accompanies this distribution, and is available
// at the URL "http://www.eclipse.org/legal/epl-v10.html".
//
// Initial Contributors:
// Nokia Corporation - initial contribution.
//
// Contributors:
//
// Description:  
//
//////////////////////////////////////////////////////////////////////////////
// Updates the current config with the image details of the image number
// supplied
//////////////////////////////////////////////////////////////////////////////

entry &imageNum

if "&imageNum"=="4"
(
&RamImage="&RamImage4"
&RamAddr="&RamAddr4"
)
else if "&imageNum"=="3"
(
&RamImage="&RamImage3"
&RamAddr="&RamAddr3"
)
else if "&imageNum"=="2"
(
&RamImage="&RamImage2"
&RamAddr="&RamAddr2"
)
else
(
&RamImage="&RamImage1"
&RamAddr="&RamAddr1"
)

do writecurrentconfig.cmm

print "Image #&imageNum active: &RamImage"
