//
// Copyright (c) 2008-2009 Nokia Corporation and/or its subsidiary(-ies).
// All rights reserved.
// This component and the accompanying materials are made available
// under the terms of "Eclipse Public License v1.0"
// which accompanies this distribution, and is available
// at the URL "http://www.eclipse.org/legal/epl-v10.html".
//
// Initial Contributors:
// Nokia Corporation - initial contribution.
//
// Contributors:
//
// Description:  
//
////////////////////////////////////////////////////////////////////////////////
//
// SOURCE PATHS
//
// Source paths is a very complicated topic.  For a better tutorial about them,
// visit the Trace32 wiki:
//
//    http://wikis.in.nokia.com/BoardSupportPackagesSymbian/T32
//
// The basics of source paths are:
//
//  - they are used in the order they are defined
//  - if a source file is found by following a path, it will be ignored if it
//    exists in another path.  ie. the first one found sticks.
//  - The classic example is main.cpp as it exists in many test executeables.
//  - This is a problem when you are debugging and the file you want is not the
//    first on the list.
//  - you resolve this by ordering the source paths correctly so that the file
//    you are interested in gets found first.
//
// Other underlying commands that are used by the scripts, so hopefully you
// don't have to:
//
//  - SYMBOL.SPATH.RESET will clear out the current source path list
//  - STORE <filename> SPATH will save the source paths to a file
//  - DO <filename> will reload the source paths from a file
//
////////////////////////////////////////////////////////////////////////////////
; extract the drive letter and add it to the symbol path
//&driveletter=string.mid(os.file.path(&_SYMBOLICS_FILENAME),0.,2.)

SYMBOL.SPATH.RESET
SYMBOL.SPATH.SETRECURSEDIR "&driveletter&sospath\os\boardsupport\naviengine"
SYMBOL.SPATH.SETRECURSEDIR "&driveletter&sospath\os\kernelhwsrv\kernel\eka\drivers"
SYMBOL.SPATH.SETRECURSEDIR "&driveletter&sospath\os\kernelhwsrv\kernel\eka\nkernsmp"
SYMBOL.SPATH.SETRECURSEDIR "&driveletter&sospath\os\kernelhwsrv\kernel\eka\kernel"
SYMBOL.SPATH.SET           "&driveletter\epoc32\release\armv5smp\UDEB"

