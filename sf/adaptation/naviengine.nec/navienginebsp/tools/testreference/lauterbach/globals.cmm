//
// Copyright (c) 2008-2009 Nokia Corporation and/or its subsidiary(-ies).
// All rights reserved.
// This component and the accompanying materials are made available
// under the terms of "Eclipse Public License v1.0"
// which accompanies this distribution, and is available
// at the URL "http://www.eclipse.org/legal/epl-v10.html".
//
// Initial Contributors:
// Nokia Corporation - initial contribution.
//
// Contributors:
//
// Description:  
//
//////////////////////////////////////////////////////////////////////////////
//
// Defines all of the global variables that represent the boards that the T32
// script system supports, and the paths to the ROM images for those boards.
// This is designed to be used in conjunction with the board configuration
// system to be found in configdialog.cmm.
//
//////////////////////////////////////////////////////////////////////////////

// General Globals
GLOBAL &_BASELOC
GLOBAL &PlatformsDir
GLOBAL &TMPDIR
GLOBAL &UserConfigCmm

// User's Platform Config
GLOBAL &Platform
GLOBAL &AutoloadModule
GLOBAL &RamAddr
GLOBAL &RamImage
GLOBAL &RamAddr1
GLOBAL &RamImage1
GLOBAL &RamAddr2
GLOBAL &RamImage2
GLOBAL &RamAddr3
GLOBAL &RamImage3
GLOBAL &RamAddr4
GLOBAL &RamImage4
GLOBAL &FlashAddr
GLOBAL &FlashImage
GLOBAL &FlashWriteProtect
GLOBAL &FlashEraseProtect
GLOBAL &BootAddr
GLOBAL &BootImage

// Platform Config
// Generic Trace32 settings
GLOBAL &CpuType
GLOBAL &JtagClock
GLOBAL &NumberOfCpus

// On Chip Triggers
GLOBAL &OnChipTriggerFiq
GLOBAL &OnChipTriggerIrq
GLOBAL &OnChipTriggerDabort
GLOBAL &OnChipTriggerPabort
GLOBAL &OnChipTriggerSwi
GLOBAL &OnChipTriggerUndef
GLOBAL &OnChipTriggerReset
GLOBAL &OnChipTriggerAlignment
GLOBAL &OnChipTriggerStepvector
GLOBAL &OnChipTriggerAddress
GLOBAL &OnChipTriggerError


// System Options
GLOBAL &SystemOptionEnreset
GLOBAL &SystemOptionTurbo
GLOBAL &SystemOptionDismode
GLOBAL &SystemOptionNoircheck
GLOBAL &SystemOptionWaitreset
GLOBAL &SystemOptionResbreak
GLOBAL &SystemOptionDacr
GLOBAL &SystemOptionTidbgen
GLOBAL &SystemOptionPwrCheck
GLOBAL &SystemOptionNoSecureFix

// Flash options
GLOBAL &FlashType
GLOBAL &FlashBlockSize
GLOBAL &FlashStart
GLOBAL &FlashLength
GLOBAL &FlashEnd
GLOBAL &FlashWidth
GLOBAL &FlashOptionTarget

GLOBAL &SystemConfigCorebase0
GLOBAL &SystemConfigCorebase1
GLOBAL &SystemConfigCtibase0
GLOBAL &SystemConfigCtibase1
GLOBAL &SystemConfigEtmfunnelport
GLOBAL &SystemConfigFunnelbase
GLOBAL &SystemConfigEtmbase
GLOBAL &SystemConfigEtbbase
GLOBAL &SystemConfigTpiubase

//////////////////////////////////////////////////////////////////////////////
// Set the global config
//////////////////////////////////////////////////////////////////////////////
&PlatformsDir="Platforms"
&TMPDIR=os.ptd()
&UserConfigCmm="userconfig.cmm"

if os.file("currentconfig.cmm")
	(
	do currentconfig.cmm
	)

if os.file("&PlatformsDir\&Platform\platformconfig.cmm")
(
	do &PlatformsDir\&Platform\platformconfig.cmm
)
